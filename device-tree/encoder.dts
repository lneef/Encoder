/dts-v1/;
/plugin/;

&amba {
    #address-cells = <2>;
    #size-cells = <2>;
    encoder@80000000 {
        compatible = "encoder";
        reg = <0x0 0x80000000 0x0 0x1000>;
    };
	  debouncer_0 {
        compatible = "debouncer";
        interrupts = <0 89 1>;
		    interrupt-parent = <&gic>;
    };
	  debouncer_1 {
        compatible = "debouncer";
        interrupts = <0 90 1>;
		    interrupt-parent = <&gic>;
    };
};


